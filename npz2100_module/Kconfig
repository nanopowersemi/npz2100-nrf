## npz2100_sample/build/Kconfig/boards/Kconfig
```kconfig
# Load Zephyr board Kconfig descriptions.
osource "C:/work/ncs/v3.0.2/zephyr/boards/nordic/nrf52833dk/Kconfig"
```

## npz2100_sample/build/npz2100_sample/Kconfig/arch/Kconfig
```kconfig
# Load Zephyr Arch Kconfig descriptions.
osource "C:/work/ncs/v3.0.2/zephyr/arch/x86/Kconfig"
osource "C:/work/ncs/v3.0.2/zephyr/arch/xtensa/Kconfig"
osource "C:/work/ncs/v3.0.2/zephyr/arch/sparc/Kconfig"
osource "C:/work/ncs/v3.0.2/zephyr/arch/riscv/Kconfig"
osource "C:/work/ncs/v3.0.2/zephyr/arch/posix/Kconfig"
osource "C:/work/ncs/v3.0.2/zephyr/arch/nios2/Kconfig"
osource "C:/work/ncs/v3.0.2/zephyr/arch/mips/Kconfig"
osource "C:/work/ncs/v3.0.2/zephyr/arch/arm64/Kconfig"
osource "C:/work/ncs/v3.0.2/zephyr/arch/arm/Kconfig"
osource "C:/work/ncs/v3.0.2/zephyr/arch/arc/Kconfig"
```

## npz2100_sample/build/npz2100_sample/Kconfig/boards/Kconfig.defconfig
```kconfig
# Load Zephyr board defconfig descriptions.
osource "C:/work/ncs/v3.0.2/zephyr/boards/nordic/nrf52833dk/Kconfig.defconfig"
```
